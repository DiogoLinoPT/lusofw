#include "UITask.h"
#include "target.h"
#include <Arduino.h>
#include <helpers/CommonCLI.h>
#include <target.h>

#ifndef USER_BTN_PRESSED
#define USER_BTN_PRESSED LOW
#endif

#define AUTO_OFF_MILLIS      20000  // 20 seconds
#define BOOT_SCREEN_MILLIS   5000   // 5 seconds
#define BATT_REFRESH_MILLIS  60000  // 60 seconds
#define POWEROFF_DELAY       3000

// LiPo discharge curve: per-cell open-circuit voltage (mV) -> remaining capacity (%).
// Approximates a standard 1S LiPo at a low discharge rate; linearly interpolated
// between points. Result clamped to [0, 100].
static const struct { uint16_t milliVolts; uint8_t percent; } lipo_discharge_curve[] = {
  { 4200, 100 }, { 4150, 95 }, { 4100, 90 }, { 4050, 85 }, { 4000, 80 },
  { 3950, 74 }, { 3900, 68 }, { 3850, 60 }, { 3800, 50 }, { 3750, 38 },
  { 3700, 28 }, { 3650, 18 }, { 3600, 10 }, { 3500,  5 }, { 3300,  0 },
};

#ifndef BATT_MIN_MILLIVOLTS
  #define BATT_MIN_MILLIVOLTS 3000
#endif
#ifndef BATT_MAX_MILLIVOLTS
  #define BATT_MAX_MILLIVOLTS 4200
#endif

// Maps a battery voltage to a state-of-charge percentage using the curve above.
// The number of cells in series is derived from BATT_MAX_MILLIVOLTS, so the same
// per-cell curve works for 1S (4.2 V) and 2S (8.4 V) packs.
static int lipoPercentFromMilliVolts(uint16_t batteryMilliVolts) {
  const int numCells = (BATT_MAX_MILLIVOLTS + 2099) / 4200;   // round(4.2 V per cell)
  const uint16_t cellMilliVolts = batteryMilliVolts / numCells;

  const int n = sizeof(lipo_discharge_curve) / sizeof(lipo_discharge_curve[0]);
  if (cellMilliVolts >= lipo_discharge_curve[0].milliVolts) return 100;
  if (cellMilliVolts <= lipo_discharge_curve[n - 1].milliVolts) return 0;

  for (int i = 0; i < n - 1; i++) {
    const uint16_t vHi = lipo_discharge_curve[i].milliVolts;
    const uint16_t vLo = lipo_discharge_curve[i + 1].milliVolts;
    if (cellMilliVolts <= vHi && cellMilliVolts >= vLo) {
      const int pHi = lipo_discharge_curve[i].percent;
      const int pLo = lipo_discharge_curve[i + 1].percent;
      return pLo + (int)(cellMilliVolts - vLo) * (pHi - pLo) / (int)(vHi - vLo);
    }
  }
  return 0;
}

// 'meshcore', 128x64px
static const uint8_t meshcore_logo [] PROGMEM = {
    0x00, 0x00, 0x00, 0x00, 0x00, 0x00, 0x00, 0x00, 0x00, 0x00, 0x00, 0x00, 0x00, 0x00, 0x00, 0x00, 
    0x00, 0x00, 0x00, 0x00, 0x00, 0x00, 0x00, 0x00, 0x00, 0x00, 0x00, 0x00, 0x00, 0x00, 0x00, 0x00, 
    0x00, 0x00, 0x00, 0x00, 0x00, 0x00, 0x00, 0x00, 0x00, 0x00, 0x00, 0x00, 0x00, 0x00, 0x00, 0x00, 
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    0x00, 0x00, 0x00, 0x00, 0x00, 0x00, 0x00, 0x00, 0x00, 0x00, 0x00, 0x00, 0x00, 0x00, 0x00, 0x00, 
};

void UITask::begin(NodePrefs* node_prefs, const char* build_date, const char* firmware_version) {
  _prevBtnState = HIGH;
  _auto_off = millis() + AUTO_OFF_MILLIS;
  _started_at = millis();
  _node_prefs = node_prefs;
  _cached_batt_mv = 0;
  _next_batt_chck = 0;
  _display->turnOn();

#if defined(PIN_USER_BTN) && defined(DISPLAY_CLASS)
  user_btn.begin();
#endif

  // strip off dash and commit hash by changing dash to null terminator
  // e.g: v1.2.3-abcdef -> v1.2.3
  char *version = strdup(firmware_version);
  char *dash = strchr(version, '-');
  if(dash){
    *dash = 0;
  }

  // v1.2.3 (1 Jan 2025)
  snprintf(_version_info, sizeof(_version_info), "%s (%s)", version, build_date);
  free(version);
}

void UITask::renderCurrScreen() {
  char tmp[80];
  if (millis() < _started_at + BOOT_SCREEN_MILLIS) { // boot screen
    // meshcore logo
    _display->setColor(UIColor::corp_blue);
    int logoX = (_display->width() - 128) / 2;
    int logoY = (_display->height() - 64) / 2;
    _display->drawXbm(logoX, logoY, meshcore_logo, 128, 64);

    // meshcore website
    const char *website = "https://meshcore.pt";
    _display->setColor(UIColor::primary_txt);
    _display->setTextSize(1);
    _display->drawTextCentered(_display->width() / 2, logoY + 44, website);

    // version info
    _display->setColor(UIColor::secondary_txt);
    _display->setTextSize(1);
    _display->drawTextCentered(_display->width() / 2, logoY + 54, _version_info);

  } else if (_powering_off_at > 0) {
    // meshcore logo
    _display->setColor(UIColor::corp_blue);
    int logoX = (_display->width() - 128) / 2;
    int logoY = (_display->height() - 64) / 2;
    _display->drawXbm(logoX, logoY, meshcore_logo, 128, 64);

    // meshcore website
    const char *website = "https://meshcore.pt";
    _display->setColor(UIColor::primary_txt);
    _display->setTextSize(1);
    _display->drawTextCentered(_display->width() / 2, logoY + 44, website);

    // Powering off
    const char* poweroff_string = "Turning OFF";
    _display->setColor(UIColor::secondary_txt);
    _display->setTextSize(1);
    _display->drawTextCentered(_display->width() / 2, logoY + 54, poweroff_string);
  } else {
    _display->setCursor(0, 0);
    _display->setTextSize(1);
    _display->setColor(UIColor::primary_txt);
    _display->print(_node_prefs->node_name);

    // freq / sf
    _display->setCursor(0, 20);
    sprintf(tmp, "FREQ: %06.3f SF%d", _node_prefs->freq, _node_prefs->sf);
    _display->print(tmp);

    // bw / cr
    _display->setCursor(0, 30);
    sprintf(tmp, "BW: %03.2f CR: %d", _node_prefs->bw, _node_prefs->cr);
    _display->print(tmp);

    // battery percent (bottom-right corner)
    renderBatteryPercent();
  }
}

void UITask::renderBatteryPercent() {
  int batteryPercentage = lipoPercentFromMilliVolts(_cached_batt_mv);

  char tmp[8];
  sprintf(tmp, "%d%%", batteryPercentage);

  _display->setColor(UIColor::primary_txt);
  _display->setTextSize(1);
  _display->drawTextRightAlign(_display->width(), _display->height() - 8, tmp);
}

void UITask::loop() {
#if defined(PIN_USER_BTN) && defined(DISPLAY_CLASS)
  int ev = user_btn.check();
  if (ev == BUTTON_EVENT_CLICK) {
    if (_display->isOn()) {
      // TODO: any action ?
    } else {
      _display->turnOn();
    }
    _auto_off = millis() + AUTO_OFF_MILLIS;   // extend auto-off timer
  } else if (ev == BUTTON_EVENT_LONG_PRESS) {
      _display->turnOn();
      Serial.println("Powering Off");
      _powering_off_at = millis() + POWEROFF_DELAY; 
  }
#endif

  if (_display->isOn()) {
    if (millis() > _next_batt_chck) {
      _cached_batt_mv = board.getBattMilliVolts();
      _next_batt_chck = millis() + BATT_REFRESH_MILLIS;
    }
    if (millis() >= _next_refresh) {
      _display->startFrame();
      renderCurrScreen();
      _display->endFrame();

      _next_refresh = millis() + 1000;   // refresh every second
    }
    if (millis() > _auto_off) {
      _display->turnOff();
    }
  }

  if (_powering_off_at > 0) { // power off timer armed
#ifdef LED_PIN
    digitalWrite(LED_PIN, LED_STATE_ON); // switch on the led until poweroff
#endif
    if (millis() > _powering_off_at) {
      _board->powerOff();  // should not return
    }
  }
}
